## buildroot/package/ingenic/Config.in
```kconfig
menuconfig BR2_PACKAGE_INGENIC
	bool "ingenic packages"
	help
	  This option enables the ingenic packages

if BR2_PACKAGE_INGENIC
	source "package/ingenic/wifi/Config.in"
	source "package/ingenic/system_config/Config.in"
endif
```

## buildroot/package/ingenic/system_config/Config.in
```kconfig
menuconfig BR2_PACKAGE_SYSTEM_CONFIG
	bool "system config for rootfs"
	default y
	help
	  The ingenic customize for your system

if BR2_PACKAGE_SYSTEM_CONFIG

config BR2_SYSTEM_CONFIG_ENABLE_ROOT_LOGIN
    bool "enable root login use /bin/sh, and no password"
    depends on !BR2_TARGET_GENERIC_GETTY && !BR2_TARGET_ENABLE_ROOT_LOGIN

config BR2_SYSTEM_CONFIG_LOGIN_TTY_PORT
    string "login tty port"
    default "ttyS0"
    depends on BR2_SYSTEM_CONFIG_ENABLE_ROOT_LOGIN

config BR2_SYSTEM_CONFIG_ENABLE_ADB
    bool "enable adb service"
    default y

config BR2_SYSTEM_CONFIG_ADB_DEVICE_USE_DIFFERENT_NAME
    bool "adb device use diffrent name"
    depends on BR2_SYSTEM_CONFIG_ENABLE_ADB

config BR2_SYSTEM_CONFIG_ADB_DEVICES_NAME_PREFIX
    string "adb devices name prefix"
    default "Duros"
    depends on BR2_SYSTEM_CONFIG_ENABLE_ADB

config BR2_SYSTEM_CONFIG_START_ADB_SERVER
    bool "start adb server when system is start"
    default y
    depends on BR2_SYSTEM_CONFIG_ENABLE_ADB


config BR2_SYSTEM_CONFIG_SET_DNS_SERVER
    bool "set dns server"

config BR2_SYSTEM_CONFIG_UTILS_MOUNT_UBIFS
    bool "install mount_ubifs.sh"
    select BR2_PACKAGE_MTD
    select BR2_PACKAGE_MTD_FLASH_ERASE
    select BR2_PACKAGE_MTD_UBIATTACH
    select BR2_PACKAGE_MTD_UBIFORMAT
    select BR2_PACKAGE_MTD_UBIMKVOL

config BR2_SYSTEM_CONFIG_CACHEDNS
    bool "cache dns"
    default n

config BR2_SYSTEM_CONFIG_MOUNT_USR_DATA_UBI
    bool "mount usr data: mount_ubifs.sh userdata /usr/data/"
	 select BR2_SYSTEM_CONFIG_UTILS_MOUNT_UBIFS

config BR2_SYSTEM_CONFIG_QT4_TP_DEV
    string "qt4 touch screen device"
    default ""
    help
        e.g one device "linuxinput:/dev/input/event0"
        e.g two device "linuxinput:/dev/input/event0 linuxinput:/dev/input/event1"
        more device Separate witch ' '(space)

config BR2_SYSTEM_CONFIG_QT4_KEYBOARD_DEV
    string "qt4 key board device"
    default ""
    help
        e.g one device "linuxinput:/dev/input/event0"
        e.g two device "linuxinput:/dev/input/event0 linuxinput:/dev/input/event1"
        more device Separate witch ' '(space)

config BR2_SYSTEM_CONFIG_QT4_QWS_SIZE
    string "qt4 qws size"
    default "480x320"
    help
        e.g "width*height"

config BR2_SYSTEM_CONFIG_QT4_QWS_DISPLAY
    string "qt4 qws display"
    default "LinuxFB:mmWidth130:mmHeight89:0"
    help
        e.g "LinuxFB:mmWidth130:mmHeight89:0"

endif # BR2_PACKAGE_SYSTEM_CONFIG
```

## buildroot/package/ingenic/wifi/Config.in
```kconfig
menuconfig BR2_PACKAGE_WIFI
	bool "wifi"
    default y
	help
	  ingenic wifi support

if BR2_PACKAGE_WIFI

source "package/ingenic/wifi/wifi_common/Config.in"

if !BR2_PACKAGE_WIFI_COMMON

menu "select wifi chip"

source "package/ingenic/wifi/wifi_bcm/Config.in"
source "package/ingenic/wifi/wifi_rtk/Config.in"
source "package/ingenic/wifi/wifi_esp8089/Config.in"

endmenu

config BR2_PACKAGE_WPA_SUPPLICANT
    bool "wifi use wpa_supplicant"
    default n
    depends on BR2_PACKAGE_WIFI
    help
        wifi use wpa_supplicant

config BR2_PACKAGE_WIFI_WPA_SUPPLICANT_CONF
    string "wpa_supplicant.conf file path"
    default "/usr/data/wpa_supplicant.conf"
    depends on BR2_PACKAGE_WPA_SUPPLICANT

config BR2_PACKAGE_WIFI_HOSTAP_CONF
    string "hostapd.conf file path"
    default "/usr/data/hostapd.conf"
    depends on BR2_PACKAGE_WIFI_AP_MODE

config BR2_PACKAGE_WIFI_HOSTAP_INTERFACE
    string "hostap interface"
    default "wlan1"
    depends on BR2_PACKAGE_WIFI_AP_MODE

config BR2_PACKAGE_WIFI_STARTUP
    bool "wifi auto startup"
    default y
    depends on BR2_PACKAGE_WPA_SUPPLICANT
    help
        wifi auto startup.

source "package/ingenic/wifi/wifi_ap_mode/Config.in"

config BR2_PACKAGE_WIFIMAC_ADDR
    string "wifi mac address"
    default "C8:93:46:45:C3:80"
    help
        Please replace it with the new MAC address.

endif

config BR2_PACKAGE_WIFIMAC_ADDR_PATH
    string "wifi mac address path"
    default "/data/misc/wifi/"
    help
        Must be equal to the value of macro "WIFIMAC_ADDR_PATH" in the firmware,
        eg. /data/misc/wifi/

endif
```

## buildroot/package/ingenic/wifi/wifi_ap_mode/Config.in
```kconfig
config BR2_PACKAGE_WIFI_AP_MODE
    bool "wifi use ap mode"
    default y
    depends on BR2_PACKAGE_WIFI
    select BR2_PACKAGE_DNSMASQ
    select BR2_PACKAGE_HOSTAPD
    select BR2_PACKAGE_HOSTAPD_WPS
    help
        wifi use ap mode
```

## buildroot/package/ingenic/wifi/wifi_bcm/Config.in
```kconfig
config BR2_PACKAGE_WIFI_BCM
    bool "WIFI_BCM"
    help
        choice one of wifi_bcm

if BR2_PACKAGE_WIFI_BCM
choice
    prompt "WIFI BCM Default Select"
    help
        wifi bcm select support

source "package/ingenic/wifi/wifi_bcm/wifi_bcm_43438/Config.in"
source "package/ingenic/wifi/wifi_bcm/wifi_bcm_43362/Config.in"
source "package/ingenic/wifi/wifi_bcm/wifi_bcm_ap6256/Config.in"
endchoice

endif
```

## buildroot/package/ingenic/wifi/wifi_bcm/wifi_bcm_43362/Config.in
```kconfig
config BR2_PACKAGE_WIFI_BCM_43362
     bool "WIFI_BCM_43362"
     select BR2_PACKAGE_WPA_SUPPLICANT
     select BR2_PACKAGE_WPA_SUPPLICANT_CLI
     select BR2_PACKAGE_WPA_SUPPLICANT_PASSPHRASE
     help
         WIFI_BCM_43362
```

## buildroot/package/ingenic/wifi/wifi_bcm/wifi_bcm_43438/Config.in
```kconfig
config BR2_PACKAGE_WIFI_BCM_43438
     bool "WIFI_BCM_43438"
     select BR2_PACKAGE_WPA_SUPPLICANT
     select BR2_PACKAGE_WPA_SUPPLICANT_CLI
     select BR2_PACKAGE_WPA_SUPPLICANT_PASSPHRASE
     help
         WIFI_BCM_43438
```

## buildroot/package/ingenic/wifi/wifi_bcm/wifi_bcm_ap6256/Config.in
```kconfig
config BR2_PACKAGE_WIFI_BCM_AP6256
     bool "WIFI_BCM_ap6256"
     select BR2_PACKAGE_WPA_SUPPLICANT
     select BR2_PACKAGE_WPA_SUPPLICANT_CLI
     select BR2_PACKAGE_WPA_SUPPLICANT_PASSPHRASE
     help
         WIFI_BCM_AP6256
```

## buildroot/package/ingenic/wifi/wifi_common/Config.in
```kconfig
config BR2_PACKAGE_WIFI_COMMON
       bool "common wifi device"
       select BR2_PACKAGE_MACGEN
       help
        common wifi device.

if BR2_PACKAGE_WIFI_COMMON

menu "support wifi device list"

config BR2_PACKAGE_WIFI_COMMON_BCM43362_A2
       bool "BCM43362 A2"
       select BR2_PACKAGE_WPA_SUPPLICANT
       select BR2_PACKAGE_WPA_SUPPLICANT_CLI
       select BR2_PACKAGE_WPA_SUPPLICANT_PASSPHRASE
       help
         BCM43362 A2

config BR2_PACKAGE_WIFI_COMMON_BCM43438_A0
       bool "BCM43438 A0"
       select BR2_PACKAGE_WPA_SUPPLICANT
       select BR2_PACKAGE_WPA_SUPPLICANT_CLI
       select BR2_PACKAGE_WPA_SUPPLICANT_PASSPHRASE
       help
         BCM43438 A0

config BR2_PACKAGE_WIFI_COMMON_BCM43438_A1
       bool "BCM43438 A1"
       select BR2_PACKAGE_WPA_SUPPLICANT
       select BR2_PACKAGE_WPA_SUPPLICANT_CLI
       select BR2_PACKAGE_WPA_SUPPLICANT_PASSPHRASE
       help
         BCM43438 A1

config BR2_PACKAGE_WIFI_COMMON_BCM4345
       bool "BCM4345"
       select BR2_PACKAGE_WPA_SUPPLICANT
       select BR2_PACKAGE_WPA_SUPPLICANT_CLI
       select BR2_PACKAGE_WPA_SUPPLICANT_PASSPHRASE
       help
         BCM4345

config BR2_PACKAGE_WIFI_COMMON_RTL8723DS
       bool "rtl8723ds"
       select BR2_PACKAGE_WPA_SUPPLICANT
       select BR2_PACKAGE_WPA_SUPPLICANT_CLI
       select BR2_PACKAGE_WPA_SUPPLICANT_PASSPHRASE
       help
         rtl8723ds

config BR2_PACKAGE_WIFI_COMMON_ESP8089
       bool "esp8089"
       select BR2_PACKAGE_WPA_SUPPLICANT
       select BR2_PACKAGE_WPA_SUPPLICANT_CLI
       select BR2_PACKAGE_WPA_SUPPLICANT_PASSPHRASE
       help
         esp8089

endmenu

endif
```

## buildroot/package/ingenic/wifi/wifi_esp8089/Config.in
```kconfig
config BR2_PACKAGE_WIFI_ESP8089
    bool "WIFI_esp8089"
    select BR2_PACKAGE_RFKILL
    help
        default used wifi_esp8089

if BR2_PACKAGE_ESP8089

source "package/ingenic/wifi/wifi_esp8089/wifi_esp8089/Config.in"

endif
```

## buildroot/package/ingenic/wifi/wifi_esp8089/wifi_esp8089/Config.in
```kconfig
choice
     prompt "select wifi firmware"
     default BR2_PACKAGE_WIFI_RTK_8723
     help
        default used WIFI_RTK_8723


config BR2_PACKAGE_WIFI_RTK_8723
     bool "WIFI_RTK_8723"
     select BR2_PACKAGE_WPA_SUPPLICANT
     select BR2_PACKAGE_WPA_SUPPLICANT_CLI
     select BR2_PACKAGE_WPA_SUPPLICANT_PASSPHRASE
     help
         WIFI_RTK_8723

endchoice
```

## buildroot/package/ingenic/wifi/wifi_rtk/Config.in
```kconfig
config BR2_PACKAGE_WIFI_RTK
    bool "WIFI_RTK"
    select BR2_PACKAGE_RFKILL
    help
        default used wifi_rtk_8723

if BR2_PACKAGE_WIFI_RTK

source "package/ingenic/wifi/wifi_rtk/wifi_rtk_8723/Config.in"

endif
```

## kernel-4.4.93/arch/mips/xburst2/Kconfig
```kconfig
if MACH_XBURST2

menu "SOC Type Selection"
	depends on MACH_XBURST2


choice
	prompt "SOC types"
	depends on MACH_XBURST2
	default SOC_X2000


config SOC_X2000
	bool "x2000"
	select IRQ_INGENIC_CPU
	select CLK_X2000
	select INGENIC_INTC_CHIP
	select PINCTRL
	select PINCTRL_INGENIC
	select BUILTIN_DTB
	select CLKSRC_OF
	select CLKDEV_LOOKUP
	select CLKSRC_INGENIC_CORE_OST


config SOC_X2000_V12
	bool "x2000-v12"
	select IRQ_INGENIC_CPU
	select CLK_X2000_V12
	select INGENIC_INTC_CHIP
	select PINCTRL
	select PINCTRL_INGENIC
	select BUILTIN_DTB
	select CLKSRC_OF
	select CLKDEV_LOOKUP
	select CLKSRC_INGENIC_CORE_OST

endchoice

choice
	prompt "device tree select"
	default DT_NONE
config DT_NONE

if SOC_X2000
source "arch/mips/xburst2/soc-x2000/Kconfig.DT"
endif

if SOC_X2000_V12
source "arch/mips/xburst2/soc-x2000-v12/Kconfig.DT"
endif

endchoice

config RAW_BOOT
	bool "Raw Boot Kernel"
	select BOOT_RAW
	default n

config EXTAL_CLOCK
	depends on MACH_XBURST2
	int "extal clock in MHz"
	default 24

config FPGA_TEST
	depends on MACH_XBURST2
	bool "FPGA_TEST"
	default n

config INGENIC_GPT_CHECK
	depends on MACH_XBURST2
	bool "The physical space is larger than the virtual space"
	default y

config FASTBOOT
	bool "FastBoot"

endmenu

endif
```

## kernel-4.4.93/arch/mips/xburst2/soc-x2000-v12/Kconfig.DT
```kconfig
config DT_HALLEY5_V10
	bool "x2000-v12 halley5_v10"

config DT_HALLEY5_V20
	bool "x2000-v12 halley5_v20"

config DT_ZEBRA
	bool "x2000-v12 zebra"

config DT_ZEBRA_ISP
	bool "x2000-v12 zebra with isp camera board."

config DT_ZEBRA_CIM
	bool "x2000-v12 zebra with cim camera board."

config DT_XXZA926
    bool "x2000-v12 xxzA926"
```

## kernel-4.4.93/drivers/gpu/drm/ingenic/Kconfig
```kconfig
menuconfig DRM_INGENIC
	tristate "DRM Support for Ingenic LCDC Display Controller"
	depends on DRM && OF
	select DRM_KMS_HELPER
	select DRM_KMS_FB_HELPER
	select DRM_KMS_CMA_HELPER
	select DRM_GEM_CMA_HELPER
	select DRM_PANEL
	select VIDEOMODE_HELPERS
	select BACKLIGHT_CLASS_DEVICE
	select BACKLIGHT_LCD_SUPPORT
	help
	  Choose this option if you have an Ingenic SoC with LCDC display
	  controller

config DRM_INGENIC_X2000
	tristate "Ingenic X2000 DPU Display Controller"
	depends on DRM_INGENIC
	help
	  Choose this option if you want to use ingenic x2000 dpu.
```

## kernel-4.4.93/drivers/media/i2c/ingenic-isp/Kconfig
```kconfig
comment "ingenic-isp camera sensor drivers"


config INGENIC_ISP_CAMERA_OV4689
	tristate "ov4689 camera support"
	depends on VIDEO_INGENIC_ISP && I2C
	help
	  This is a ingenic-isp camera driver for the OmniVision OV4689 sensor

config INGENIC_ISP_CAMERA_SC2232H
	tristate "sc2232h camera support"
	depends on VIDEO_INGENIC_ISP && I2C
	help
	  This is a ingenic-isp camera driver for the OmniVision sc2232h sensor

config INGENIC_ISP_CAMERA_OV2735B
	tristate "ov2735 camera DVP interface support"
	depends on VIDEO_INGENIC_ISP && I2C
	help
	  This is a ingenic-isp camera driver for the OmniVision OV2735 sensor DVP interface

config INGENIC_ISP_CAMERA_OV2735A
	tristate "ov2735 camera MIPI interface support"
	depends on VIDEO_INGENIC_ISP && I2C
	help
	  This is a ingenic-isp camera driver for the OmniVision OV2735 sensor MIPI interface
```

## kernel-4.4.93/drivers/net/ethernet/ingenic/Kconfig
```kconfig
config INGENIC_MAC
	tristate "ingenic on-chip MAC support"
	select CRC32
	select MII
	help
	  This is the driver for INGENIC on-chip mac device.

config INGENIC_MAC_DMA_INTERFACES
	bool "Ingenic mac dma interfaces"
	depends on INGENIC_MAC
	help
	  This is for MAC Dma interfaces selection
choice
	prompt "Ingenic mac dma bus interfaces"
	depends on INGENIC_MAC_DMA_INTERFACES
	default CONFIG_INGENIC_MAC_AHB_BUS

config INGENIC_MAC_AXI_BUS
	bool "MAC_AXI_BUS"
	help
	  Select for mac dma AXI bus

config INGENIC_MAC_AHB_BUS
	bool "MAC_AHB_BUS"
	help
	  Select for mac dma AHB bus
endchoice

config JZ_GMAC_USE_HWSTAMP
    bool "Use IEEE 1588 hwstamp"
	depends on INGENIC_MAC && SOC_X2000_V12
	select PTP_1588_CLOCK
	help
	  To support the IEEE 1588 Precision Time Protocol (PTP)
```

## kernel-4.4.93/drivers/video/fbdev/ingenic/x2000_v12/Kconfig
```kconfig
menuconfig FB_INGENIC_X2000_V12
	tristate "Ingenic Framebuffer Driver for X2000_v12"
	depends on FB_INGENIC
	select FB_INGENIC_DISPLAYS_X2000_V12
	select FB_CFB_FILLRECT
	select FB_CFB_COPYAREA
	select FB_CFB_IMAGEBLIT
	help
	  Framebuffer support for the X2000_v12 DPU SoC.

source "drivers/video/fbdev/ingenic/x2000_v12/displays/Kconfig"
```

## kernel-4.4.93/drivers/video/fbdev/ingenic/x2000_v12/displays/Kconfig
```kconfig
menuconfig FB_INGENIC_DISPLAYS_X2000_V12
	tristate "Supported lcd panels"
	depends on FB_INGENIC_X2000_V12
	select BACKLIGHT_LCD_SUPPORT
	select LCD_CLASS_DEVICE
	select BACKLIGHT_CLASS_DEVICE


config PANEL_X2000_V12_Y88249
	tristate "lcd panel y88249"
	depends on FB_INGENIC_DISPLAYS_X2000_V12
	help
		lcd panel y88249, for ingenicfb drivers.

config PANEL_X2000_V12_KD050HDFIA019
	tristate "lcd panel kd050hdfia019"
	depends on FB_INGENIC_DISPLAYS_X2000_V12
	help
		lcd panel kd050hdfia019, for ingenicfb drivers.

config PANEL_X2000_V12_MA0060
	tristate "lcd panel MA0060"
	depends on FB_INGENIC_DISPLAYS_X2000_V12
	help
		lcd panel MA0060, for ingenicfb drivers.
```
